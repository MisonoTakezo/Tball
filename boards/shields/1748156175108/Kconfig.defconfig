## boards/shields/1748156175108/Kconfig.defconfig
```kconfig
if SHIELD_1748156175108_RIGHT

config ZMK_KEYBOARD_NAME
    default "1748156175108"

endif

if SHIELD_1748156175108_LEFT || SHIELD_1748156175108_RIGHT

config ZMK_SPLIT
    default y

endif
```

## boards/shields/1748156175108/Kconfig.shield
```kconfig
config SHIELD_1748156175108_LEFT
    def_bool $(shields_list_contains,1748156175108_left)
config SHIELD_1748156175108_RIGHT
    def_bool $(shields_list_contains,1748156175108_right)
```

## boards/shields/Tball/Kconfig.defconfig
```kconfig
if SHIELD_TBALL_RIGHT

config ZMK_KEYBOARD_NAME
    default "Tball"

endif

if SHIELD_TBALL_LEFT || SHIELD_TBALL_RIGHT

config ZMK_SPLIT
    default y

endif
```

## boards/shields/Tball/Kconfig.shield
```kconfig
config SHIELD_TBALL_LEFT
    def_bool $(shields_list_contains,Tball_left)
config SHIELD_TBALL_RIGHT
    def_bool $(shields_list_contains,Tball_right)
```

## config/west.yml
```yaml
manifest:
  remotes:
    - name: zmkfirmware
      url-base: https://github.com/zmkfirmware
    - name: sekigon-gonnoc
      url-base: https://github.com/sekigon-gonnoc
    - name: MisonoTakezo
      url-base: https://github.com/MisonoTakezo
  projects:
    - name: zmk
      remote: zmkfirmware
      revision: main
      import: app/west.yml
    - name: zmk-driver-paw3222-alpha
      remote: MisonoTakezo
      revision: main
  self:
    path: config
```
